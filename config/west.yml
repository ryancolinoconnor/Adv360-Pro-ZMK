## config/west.yml
```yaml
manifest:
  remotes:
    - name: zmkfirmware
      url-base: https://github.com/ftc
    - name: refil
      url-base: https://github.com/ryancolinoconnor
  projects:
    - name: zmk
      remote: refil
      revision: mouse-ftc-adv-360-z3
      import: app/west.yml
  self:
    path: config
```
